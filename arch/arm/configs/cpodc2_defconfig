## arch/arm/configs/cpodc2_defconfig
```kconfig
CONFIG_ARCH_AT91SAM9261=y
CONFIG_MACH_CPODC2_9261=y
CONFIG_MACH_CPODC2=y
CONFIG_AEABI=y
# CONFIG_CMD_ARM_CPUINFO is not set
# CONFIG_AT91SAM9_LOWLEVEL_INIT is not set
CONFIG_MTD_NAND_ATMEL_BUSWIDTH_16=y
CONFIG_ARM_OPTIMZED_STRING_FUNCTIONS=y
CONFIG_ARM_BOARD_APPEND_ATAG=y
CONFIG_CPODC2_MSP430=y
CONFIG_MMU=y
CONFIG_BAREBOX_MAX_IMAGE_SIZE=0x39C00
CONFIG_PBL_IMAGE=y
CONFIG_EXPERIMENTAL=y
CONFIG_MALLOC_TLSF=y
CONFIG_PROMPT="CPODC_2.0:"
CONFIG_LONGHELP=y
CONFIG_GLOB=y
CONFIG_HUSH_FANCY_PROMPT=y
CONFIG_CMDLINE_EDITING=y
CONFIG_AUTO_COMPLETE=y
# CONFIG_MENU is not set
# CONFIG_CONSOLE_ACTIVATE_FIRST is not set
CONFIG_CONSOLE_ACTIVATE_ALL=y
CONFIG_DEFAULT_ENVIRONMENT=y
CONFIG_DEFAULT_ENVIRONMENT_GENERIC_NEW=y
CONFIG_DEFAULT_ENVIRONMENT_PATH="arch/arm/boards/cpodc2/env"
CONFIG_CMD_EDIT=y
CONFIG_CMD_SLEEP=y
CONFIG_CMD_SAVEENV=y
CONFIG_CMD_EXPORT=y
CONFIG_CMD_PRINTENV=y
CONFIG_CMD_READLINE=y
# CONFIG_CMD_MENU is not set
# CONFIG_CMD_PASSWD=y
CONFIG_CMD_CLEAR=y
CONFIG_CMD_ECHO_E=y
CONFIG_CMD_LOADB=y
CONFIG_CMD_MEMINFO=y
CONFIG_CMD_MTEST=y
CONFIG_CMD_MSLEEP=y
CONFIG_CMD_FLASH=y
CONFIG_CMD_BOOTM_SHOW_TYPE=y
CONFIG_CMD_BOOTM_INITRD=y
CONFIG_CMD_UIMAGE=y
# CONFIG_CMD_BOOTU is not set
CONFIG_CMD_RESET=y
CONFIG_CMD_GO=y
CONFIG_CMD_TIMEOUT=y
CONFIG_CMD_PARTITION=y
CONFIG_CMD_GPIO=y
CONFIG_CMD_MAGICVAR=y
# CONFIG_CMD_LED is not set
# CONFIG_CMD_LED_TRIGGER is not set
# CONFIG_NET is not set
# CONFIG_NET_DHCP is not set
# CONFIG_NET_NFS is not set
# CONFIG_NET_PING is not set 
# CONFIG_NET_TFTP is not set
# CONFIG_NET_TFTP_PUSH is not set
# CONFIG_NET_RESOLV is not set
# CONFIG_DRIVER_NET_DM9K is not set
CONFIG_SPI=y
CONFIG_DRIVER_SPI_ATMEL=y
CONFIG_CMD_SPI=y
CONFIG_MTD=y
CONFIG_MTD_DATAFLASH=y
# CONFIG_MTD_OOB_DEVICE is not set
CONFIG_NAND=y
# CONFIG_NAND_ECC_HW is not set
# CONFIG_NAND_ECC_HW_SYNDROME is not set
# CONFIG_NAND_ECC_HW_NONE is not set
CONFIG_NAND_ATMEL=y
# CONFIG_UBI is not set
# CONFIG_CMD_UBIFORMAT is not set
CONFIG_USB=y
# CONFIG_USB_OHCI is not set
# CONFIG_USB_OHCI_AT91 is not set
CONFIG_USB_STORAGE=y
CONFIG_USB_HAVE_GADGET_DRIVER=y
CONFIG_USB_GADGET=y
CONFIG_USB_GADGET_DUALSPEED=y
CONFIG_USB_GADGET_DRIVER_AT91=y
CONFIG_USB_GADGET_DFU=y
CONFIG_USB_GADGET_SERIAL=y
# CONFIG_LED=y
# CONFIG_LED_GPIO=y
# CONFIG_LED_TRIGGERS=y
# CONFIG_KEYBOARD_GPIO=y
CONFIG_GPIO_GENERIC=y
CONFIG_GPIO_GENERIC_PLATFORM=y
CONFIG_VIDEO=y
CONFIG_DRIVER_VIDEO_ATMEL=y
CONFIG_CMD_SPLASH=y
CONFIG_PNG=y
CONFIG_LODEPNG=y
```
